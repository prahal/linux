## Documentation/devicetree/bindings/clock/exynos4-clock.txt
```
* Samsung Exynos4 Clock Controller

The Exynos4 clock controller generates and supplies clock to various controllers
within the Exynos4 SoC. The clock binding described here is applicable to all
SoC's in the Exynos4 family.

Required Properties:

- compatible: should be one of the following.
  - "samsung,exynos4210-clock" - controller compatible with Exynos4210 SoC.
  - "samsung,exynos4412-clock" - controller compatible with Exynos4412 SoC.

- reg: physical base address of the controller and length of memory mapped
  region.

- #clock-cells: should be 1.

- samsung,armclk-divider-table: when the frequency of the APLL is changed
  the divider clocks in CMU_CPU clock domain also need to be updated. These
  divider clocks have SoC specific divider clock output requirements for a
  specific APLL clock speeds. When APLL clock rate is changed, these divider
  clocks are reprogrammed with pre-determined values in order to maintain the
  SoC specific divider clock outputs. This property lists the divider values
  for divider clocks in the CMU_CPU block for supported APLL clock speeds.
  The format of each entry included in the arm-frequency-table should be
  as defined below

  - for Exynos4210 and Exynos4212 based platforms:
      cell #1: arm clock parent frequency
      cell #2 ~ cell 9#: value of clock divider in the following order
	        corem0_ratio, corem1_ratio, periph_ratio, atb_ratio,
		pclk_dbg_ratio, apll_ratio, copy_ratio, hpm_ratio.

  - for Exynos4412 based platforms:
      cell #1: expected arm clock parent frequency
      cell #2 ~ cell #10: value of clock divider in the following order
	       corem0_ratio, corem1_ratio, periph_ratio, atb_ratio,
               pclk_dbg_ratio, apll_ratio, copy_ratio, hpm_ratio, cores_ratio

- samsung,armclk-cells: defines the number of cells in
  samsung,armclk-divider-table property. The value of this property depends on
  the SoC type.

  - for Exynos4210 and Exynos4212: the value should be 9.
  - for Exynos4412: the value should be 10.

Each clock is assigned an identifier and client nodes can use this identifier
to specify the clock which they consume.

All available clocks are defined as preprocessor macros in
dt-bindings/clock/exynos4.h header and can be used in device
tree sources.

Example 1: An example of a clock controller node is listed below.

	clock: clock-controller@0x10030000 {
		compatible = "samsung,exynos4210-clock";
		reg = <0x10030000 0x20000>;
		#clock-cells = <1>;

		samsung,armclk-cells = <9>;
		samsung,armclk-divider-table = <1200000 3 7 3 4 1 7 5 0>,
					       <1000000 3 7 3 4 1 7 4 0>,
					       < 800000 3 7 3 3 1 7 3 0>,
					       < 500000 3 7 3 3 1 7 3 0>,
					       < 400000 3 7 3 3 1 7 3 0>,
					       < 200000 1 3 1 1 1 0 3 0>;
	};

Example 2: UART controller node that consumes the clock generated by the clock
	   controller. Refer to the standard clock bindings for information
	   about 'clocks' and 'clock-names' property.

	serial@13820000 {
		compatible = "samsung,exynos4210-uart";
		reg = <0x13820000 0x100>;
		interrupts = <0 54 0>;
		clocks = <&clock CLK_UART2>, <&clock CLK_SCLK_UART2>;
		clock-names = "uart", "clk_uart_baud0";
	};
```

## Documentation/devicetree/bindings/clock/exynos5250-clock.txt
```
* Samsung Exynos5250 Clock Controller

The Exynos5250 clock controller generates and supplies clock to various
controllers within the Exynos5250 SoC.

Required Properties:

- compatible: should be one of the following.
  - "samsung,exynos5250-clock" - controller compatible with Exynos5250 SoC.

- reg: physical base address of the controller and length of memory mapped
  region.

- #clock-cells: should be 1.

- samsung,armclk-divider-table: when the frequency of the APLL is changed
  the divider clocks in CMU_CPU clock domain also need to be updated. These
  divider clocks have SoC specific divider clock output requirements for a
  specific APLL clock speeds. When APLL clock rate is changed, these divider
  clocks are reprogrammed with pre-determined values in order to maintain the
  SoC specific divider clock outputs. This property lists the divider values
  for divider clocks in the CMU_CPU block for supported APLL clock speeds.
  The format of each entry included in the arm-frequency-table should be
  as defined below

      cell #1: expected arm clock parent frequency
      cell #2 ~ cell #9: value of clock divider in the following order
	       cpud_ratio, acp_ratio, periph_ratio, atb_ratio,
               pclk_dbg_ratio, apll_ratio, copy_ratio, hpm_ratio

- samsung,armclk-cells: defines the number of cells in
  samsung,armclk-divider-table property. The value of this property should be 9.

Each clock is assigned an identifier and client nodes can use this identifier
to specify the clock which they consume.

All available clocks are defined as preprocessor macros in
dt-bindings/clock/exynos5250.h header and can be used in device
tree sources.

Example 1: An example of a clock controller node is listed below.

	clock: clock-controller@0x10010000 {
		compatible = "samsung,exynos5250-clock";
		reg = <0x10010000 0x30000>;
		#clock-cells = <1>;

		samsung,armclk-cells = <9>;
		samsung,armclk-divider-table = <1700000 3 7 7 7 3 5 0 2>,
					       <1600000 3 7 7 7 1 4 0 2>,
					       <1500000 2 7 7 7 1 4 0 2>,
					       <1400000 2 7 7 6 1 4 0 2>,
					       <1300000 2 7 7 6 1 3 0 2>,
					       <1200000 2 7 7 5 1 3 0 2>,
					       <1100000 3 7 7 5 1 3 0 2>,
					       <1000000 1 7 7 4 1 2 0 2>,
					       < 900000 1 7 7 4 1 2 0 2>,
					       < 800000 1 7 7 4 1 2 0 2>,
					       < 700000 1 7 7 3 1 1 0 2>,
					       < 600000 1 7 7 3 1 1 0 2>,
					       < 500000 1 7 7 2 1 1 0 2>,
					       < 400000 1 7 7 2 1 1 0 2>,
					       < 300000 1 7 7 1 1 1 0 2>,
					       < 200000 1 7 7 1 1 1 0 2>;
	};

Example 2: UART controller node that consumes the clock generated by the clock
	   controller. Refer to the standard clock bindings for information
	   about 'clocks' and 'clock-names' property.

	serial@13820000 {
		compatible = "samsung,exynos4210-uart";
		reg = <0x13820000 0x100>;
		interrupts = <0 54 0>;
		clocks = <&clock CLK_UART2>, <&clock CLK_SCLK_UART2>;
		clock-names = "uart", "clk_uart_baud0";
	};
```

## Documentation/devicetree/bindings/cpufreq/cpufreq-boost.txt
```
* Device tree binding for CPU boost frequency (aka over-clocking)

Certain CPU's can be operated in optional 'boost' mode (or sometimes referred as
overclocking) in which the CPU can operate at frequencies which are not
specified by the manufacturer as CPU's operating frequency.

Optional Properties:
- boost-frequencies: list of frequencies in KHz to be used only in boost mode.
  This list should be a subset of frequencies listed in "operating-points"
  property. Refer to Documentation/devicetree/bindings/power/opp.txt for
  details about "operating-points" property.

Example:

	cpus {
		#address-cells = <1>;
		#size-cells = <0>;
		cpu@0 {
			device_type = "cpu";
			compatible = "arm,cortex-a9";
			reg = <0>;

			operating-points = <
				1500000 1350000
				1400000 1287500
				1300000 1250000
				1200000 1187500
				1100000 1137500
				1000000 1087500
			>;
			boost-frequencies = <1500000 1400000>;
		};
		cpu@1 {
			device_type = "cpu";
			compatible = "arm,cortex-a9";
			reg = <1>;
		};
	};
```

## Documentation/devicetree/bindings/iommu/samsung,sysmmu.txt
```
Samsung Exynos IOMMU H/W, System MMU (System Memory Management Unit)

Samsung's Exynos architecture contains System MMUs that enables scattered
physical memory chunks visible as a contiguous region to DMA-capable peripheral
devices like MFC, FIMC, FIMD, GScaler, FIMC-IS and so forth.

System MMU is an IOMMU and supports identical translation table format to
ARMv7 translation tables with minimum set of page properties including access
permissions, shareability and security protection. In addition, System MMU has
another capabilities like L2 TLB or block-fetch buffers to minimize translation
latency.

System MMUs are in many to one relation with peripheral devices, i.e. single
peripheral device might have multiple System MMUs (usually one for each bus
master), but one System MMU can handle transactions from only one peripheral
device. The relation between a System MMU and the peripheral device needs to be
defined in device node of the peripheral device.

MFC in all Exynos SoCs and FIMD, M2M Scalers and G2D in Exynos5420 has 2 System
MMUs.
* MFC has one System MMU on its left and right bus.
* FIMD in Exynos5420 has one System MMU for window 0 and 4, the other system MMU
  for window 1, 2 and 3.
* M2M Scalers and G2D in Exynos5420 has one System MMU on the read channel and
  the other System MMU on the write channel.

The drivers must consider how to handle those System MMUs. When device
have more than one SYSMMU controller it is neccessary to add
"iommu-names" property, which specifies which SYSMMU controller operates
on which bus or memory channel.

It is up to the master device driver to decide how such case will be
handled. It is possible to create separate IO address spaces for each
SYSMMU or to bind them together to one common IO address space. It is
also possible to bind more than one device to one IO address space. All
this has to be handled by master device driver in its initialization
procedure or flags and no changes to device tree nodes are needed.

In Linux kernel, the general idea is that presence of the SYSMMU
controllers is transparent to master drivers if they use standard DMA
API. When driver wants to use IO separate address spaces for each bus or
memory channel (each SYSMMU) or to bind more than one device to one IO
address space, it has to specify this to SYSMMU driver by
DRIVER_HAS_OWN_IOMMU_MANAGER flag. To get access to each SYSMMU bound to
the given device, additional child devices with special names (matching
"parent:bus" scheme) have to be registered. Once then, all standard
IOMMU operations can be performed on such child devices, what will
result in respective operations done on IO address space managed by
SYSMMU of the given name. Other operating systems might implement those
features differently.

Required properties for SYSMMU controller node:
- compatible: Should be "samsung,exynos-sysmmu"
- reg: A tuple of base address and size of System MMU registers.
- interrupt-parent: The phandle of the interrupt controller of System MMU
- interrupts: An interrupt specifier for interrupt signal of System MMU,
	      according to the format defined by a particular interrupt
	      controller.
- clock-names: Should be "sysmmu" if the System MMU is needed to gate its clock.
	       Optional "master" if the clock to the System MMU is gated by
	       another gate clock other than "sysmmu".
	       Exynos4 SoCs, there needs no "master" clock.
	       Exynos5 SoCs, some System MMUs must have "master" clocks.
- clocks: Required if the System MMU is needed to gate its clock.
- #iommu-cells: Specify number of cells describing IO address space parameters,
		can be: 0 (zero), meaning all 32bit address space is available,
		or 2, if address space is limited, first cell then stores
		base IO address, second cell contains IO window size in bytes.
- samsung,power-domain: Required if the System MMU is needed to gate its power.
	  Please refer to the following document:
	  Documentation/devicetree/bindings/arm/exynos/power_domain.txt

Required properties for master device:
- iommus: one or more phandles to the SYSMMU controller node, with optionally
	  specified IO address space (see #iommu-cells property above)
- iommu-names: if more than one SYSMMU controller is specified, this property
	       must contain names for each of them. Those names are defined by
	       the bindings for a particular master device.

For more information, please refer to generic iommu bindings defined in
iommu.txt file.

Example 1:
GScaller device with one SYSMMU controller

	gsc_0: gsc@13e00000 {
		compatible = "samsung,exynos5-gsc";
		reg = <0x13e00000 0x1000>;
		interrupts = <0 85 0>;
		samsung,power-domain = <&pd_gsc>;
		clocks = <&clock CLK_GSCL0>;
		clock-names = "gscl";
		iommus = <&sysmmu_gsc0>;
	};

	sysmmu_gsc0: sysmmu@13E80000 {
		compatible = "samsung,exynos-sysmmu";
		reg = <0x13E80000 0x1000>;
		interrupt-parent = <&combiner>;
		interrupts = <2 0>;
		clock-names = "sysmmu", "master";
		clocks = <&clock CLK_SMMU_GSCL0>, <&clock CLK_GSCL0>;
		samsung,power-domain = <&pd_gsc>;
		#iommu-cells = <0>;
	};

Example 2:
MFC Codec with two SYSMMU controllers (on "left" and "right" bus), with address
space limited to 256MiB each, left bus starts IO address space at 0x20000000,
while right bus at 0x30000000

	mfc: codec@13400000 {
		compatible = "samsung,mfc-v5";
		reg = <0x13400000 0x10000>;
		interrupts = <0 94 0>;
		samsung,power-domain = <&pd_mfc>;
		clocks = <&clock CLK_MFC>;
		clock-names = "mfc";
		status = "disabled";
		iommus = <&sysmmu_mfc_l 0x20000000 0x10000000>,
			 <&sysmmu_mfc_r 0x30000000 0x10000000>;
		iommu-names = "left", "right";
	};

	sysmmu_mfc_l: sysmmu@13620000 {
		compatible = "samsung,exynos-sysmmu";
		reg = <0x13620000 0x1000>;
		interrupt-parent = <&combiner>;
		interrupts = <5 5>;
		clock-names = "sysmmu", "master";
		clocks = <&clock CLK_SMMU_MFCL>, <&clock CLK_MFC>;
		samsung,power-domain = <&pd_mfc>;
		#iommu-cells = <2>;
	};

	sysmmu_mfc_r: sysmmu@13630000 {
		compatible = "samsung,exynos-sysmmu";
		reg = <0x13630000 0x1000>;
		interrupt-parent = <&combiner>;
		interrupts = <5 6>;
		clock-names = "sysmmu", "master";
		clocks = <&clock CLK_SMMU_MFCR>, <&clock CLK_MFC>;
		samsung,power-domain = <&pd_mfc>;
		#iommu-cells = <2>;
	};
```

## Documentation/devicetree/bindings/video/exynos_hdmi.txt
```
Device-Tree bindings for drm hdmi driver

Required properties:
- compatible: value should be one among the following:
	1) "samsung,exynos5-hdmi" <DEPRECATED>
	2) "samsung,exynos4210-hdmi"
	3) "samsung,exynos4212-hdmi"
	4) "samsung,exynos5420-hdmi"
- reg: physical base address of the hdmi and length of memory mapped
	region.
- interrupts: interrupt number to the cpu.
- hpd-gpio: following information about the hotplug gpio pin.
	a) phandle of the gpio controller node.
	b) pin number within the gpio controller.
	c) optional flags and pull up/down.
- clocks: list of clock IDs from SoC clock driver.
	a) hdmi: Gate of HDMI IP bus clock.
	b) sclk_hdmi: Gate of HDMI special clock.
	c) sclk_pixel: Pixel special clock, one of the two possible inputs of
		HDMI clock mux.
	d) sclk_hdmiphy: HDMI PHY clock output, one of two possible inputs of
		HDMI clock mux.
	e) mout_hdmi: It is required by the driver to switch between the 2
		parents i.e. sclk_pixel and sclk_hdmiphy. If hdmiphy is stable
		after configuration, parent is set to sclk_hdmiphy else
		sclk_pixel.
- clock-names: aliases as per driver requirements for above clock IDs:
	"hdmi", "sclk_hdmi", "sclk_pixel", "sclk_hdmiphy" and "mout_hdmi".
- ddc: phandle to the hdmi ddc node (this is an i2c adapter)
- phy: phandle to the hdmi pll phy node (driverless instance of an i2c device, see second example)
- samsung,syscon-phandle: phandle for system controller node for PMU.

Example:

	hdmi {
		compatible = "samsung,exynos4212-hdmi";
		reg = <0x14530000 0x100000>;
		interrupts = <0 95 0>;
		hpd-gpio = <&gpx3 7 1>;
		ddc = <&hdmi_ddc_node>;
		phy = <&hdmiphy_pll>;
		samsung,syscon-phandle = <&pmu_system_controller>;
	};

Example (hdmi pll phy):

	/* configuration for exynos4412 */
	i2c_8: i2c@138e0000 {
		status = "okay";

		samsung,i2c-slave-addr = <0x10>;
		samsung,i2c-sda-delay = <100>;
		samsung,i2c-max-bus-freq = <400000>;

		compatible = "samsung,s3c2440-hdmiphy-i2c";
		reg = <0x138e0000 0x1000>;

		interrupts = <0 93 0>;

		#address-cells = <1>;
		#size-cells = <0>;

		clocks = <&clock CLK_I2C_HDMI>;
		clock-names = "i2c";

		/* HDMI PLL PHY (driverless node) */
		hdmiphy_pll: hdmiphy@38 {
			compatible = "samsung,exynos4412-hdmiphy";
			reg = <0x38>;
		};
	};
```
